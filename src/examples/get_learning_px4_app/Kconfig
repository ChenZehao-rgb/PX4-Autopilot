## src/examples/get_learning_px4_app/Kconfig
```kconfig
menuconfig EXAMPLES_GET_LEARNING_PX4_APP
bool "get_learning_px4_app"
default n

---help---
     Enable support for get_learning_px4_app
```

## src/examples/learning_px4_app/Kconfig
```kconfig
menuconfig EXAMPLES_LEARNING_PX4_APP
bool "learning_px4_app"
default n

---help---
     Enable support for learning_px4_app
```

## src/modules/my_module/Kconfig
```kconfig
menuconfig MODULES_MY_MODULE
bool "my_module"
default n

---help---
     Enable support for my_module
```
